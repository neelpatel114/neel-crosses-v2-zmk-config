## Kconfig
```kconfig
config ZMK_BEHAVIOR_OTA_RESET
    bool "OTA reset behavior (reboot into the Adafruit bootloader's BLE DFU mode)"
    default y
    depends on DT_HAS_ZMK_BEHAVIOR_OTA_RESET_ENABLED
```
